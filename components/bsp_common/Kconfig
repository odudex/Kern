## components/bsp_common/Kconfig
```kconfig
menu "Board Support Package"

    # How a board answers the bsp_pmic API. Not prompted: each board knows its
    # own hardware, so these follow the board choice rather than the user.
    # Adding a board means adding one default line here.

    config BSP_BATTERY_PMIC
        bool
        default y if KERN_BOARD_WAVE_35 || KERN_BOARD_CROWPANEL
        help
            Board has a dedicated power-management or fuel-gauge chip and
            ships its own bsp_pmic implementation in its BSP component
            (AXP2101 on wave_35, STC8H companion MCU on crowpanel).

    config BSP_BATTERY_ADC
        bool
        default y if KERN_BOARD_WAVE_43 || KERN_BOARD_WAVE_5
        help
            Board has no PMIC and exposes the raw pack voltage on an ADC pin
            through a resistor divider. Selects the shared driver in
            components/bsp_common/pmic_adc.c, which also carries the per-board
            divider description.

    # Boards that select neither get the no-op stub and report no battery.

    config BSP_ERROR_CHECK
        bool "Enable error check in BSP"
        default y
        help
            Error check assert the application before returning the error code.

    menu "I2C"
        config BSP_I2C_NUM
            int "I2C peripheral index"
            default 1
            range 0 1
            help
                ESP32P4 has two I2C peripherals, pick the one you want to use.

        config BSP_I2C_FAST_MODE
            bool "Enable I2C fast mode"
            default y
            help
                I2C has two speed modes: normal (100kHz) and fast (400kHz).

        config BSP_I2C_CLK_SPEED_HZ
            int
            default 400000 if BSP_I2C_FAST_MODE
            default 100000
    endmenu

    menu "Display"
        config BSP_DISPLAY_BRIGHTNESS_LEDC_CH
            int "LEDC channel index"
            default 1
            range 0 7
            help
                LEDC channel is used to generate PWM signal that controls display brightness.

        config BSP_LCD_DPI_BUFFER_NUMS
            int "Set number of frame buffers"
            default 1
            range 1 3
            help
                Let DPI LCD driver create a specified number of frame-size buffers.
                Only used by MIPI DSI boards (wave_4b, wave_5).

        choice BSP_LCD_COLOR_FORMAT
            prompt "Select LCD color format"
            default BSP_LCD_COLOR_FORMAT_RGB565
            help
                Select the LCD color format RGB565/RGB888.
                Only used by MIPI DSI boards (wave_4b, wave_5).

            config BSP_LCD_COLOR_FORMAT_RGB565
                bool "RGB565"
            config BSP_LCD_COLOR_FORMAT_RGB888
                bool "RGB888"
        endchoice
    endmenu

endmenu
```

## main/Kconfig.projbuild
```kconfig
menu "Kern Configuration"

    choice KERN_BOARD
        prompt "Target board"
        default KERN_BOARD_WAVE_4B
        help
            Select the ESP32-P4 board variant.

        config KERN_BOARD_WAVE_4B
            bool "Waveshare ESP32-P4-WiFi6-Touch-LCD-4B (720x720)"

        config KERN_BOARD_WAVE_35
            bool "Waveshare ESP32-P4-WiFi6-Touch-LCD-3.5 (320x480)"

        config KERN_BOARD_WAVE_5
            bool "Waveshare ESP32-P4-WiFi6-Touch-LCD-5 (720x1280 MIPI DSI)"

        config KERN_BOARD_WAVE_43
            bool "Waveshare ESP32-P4-WiFi6-Touch-LCD-4.3 (480x800 MIPI DSI)"

        config KERN_BOARD_CROWPANEL
            bool "CrowPanel Advanced ESP32-P4 (7\" / 10.1\", 1024x600 MIPI DSI)"

        config KERN_BOARD_WAVE_7B
            bool "Waveshare ESP32-P4-WiFi6-Touch-LCD-7B (1024x600 MIPI DSI)"
    endchoice

    config KERN_PBKDF2_HW_SHA
        bool "Drive PBKDF2-HMAC-SHA256 on the P4 SHA accelerator"
        default y
        help
            Holds the SHA peripheral across batches of PBKDF2 iterations and
            precomputes the HMAC ipad/opad midstates, so an iteration costs two
            hardware block compressions instead of four compressions wrapped in
            four crypto-lock acquire/reset/release cycles.

            Output is byte-identical to the PSA path, which stays compiled in.
            Every call first runs a known-answer vector through the accelerated
            code and falls back to PSA if it disagrees.

            Turn this off to A/B against the PSA implementation on device.

    config KERN_PBKDF2_HW_SHA_CHUNK
        int "SHA hold length, in PBKDF2 iterations"
        depends on KERN_PBKDF2_HW_SHA
        default 1024
        range 16 65536
        help
            The peripheral is released and reacquired every this many
            iterations so AES and SHA stay available to the rest of the device.
            At the default one hold is about 6.6 ms -- under a 60 Hz frame --
            and reacquisition costs about 0.3% of the derivation.

            Lower it to shorten the outage, raise it to shave the reacquire
            cost.

    config KERN_PBKDF2_SELFTEST
        bool "Check and time both PBKDF2 paths at boot"
        default n
        help
            Runs known-answer vectors, then diffs the accelerated path against
            PSA across password, salt, iteration and output lengths, then times
            both. Results print prefixed PBKDF2.

            The host test suite cannot reach this code, so this is the only
            place the accelerated path is proven. Development only; it adds
            several seconds to boot.

    config KERN_SCAN_PROFILING
        bool "Log QR scanner pipeline timing once a second"
        default n
        help
            While the scanner is open, prints one line a second prefixed PROF.
            Times are average/maximum in microseconds.

            cam: camera callbacks per second. gaps: callbacks by the time since
            the previous one, in buckets <28/<39/<55/<78/>=78 ms; one frame
            period of a 45 fps sensor lands in the first and a dropped frame in
            the third. ppa: sensor frame to decode frame. prev: decode frame to
            preview. nobuf: frames skipped for want of a free buffer. ui:
            preview frames per second.

            dec: decoder passes per second. wait: decoder idle before each
            pass. gray, find, read: grayscale conversion, code location, code
            decoding.

            ok: passes that decoded. new: decodes whose payload differs from
            the previous one. skip: sequential BBQr or pMofN parts the
            animation showed and no pass decoded. none: passes that found no
            code. bad: passes that found a code they could not read.

            err: failed reads by cause: grid size, version, format ECC, data
            ECC, other. qr: version and side in pixels of the last code read;
            a version v code has 17 + 4v modules a side.

            Development only. The line is printed from an idle-priority task so
            its UART time stays off the tasks being measured. Use
            just scan-prof <board>.

endmenu
```
