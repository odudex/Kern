## components/sd_card/Kconfig
```kconfig
menu "SD Card"

    config SD_CLK_GPIO
        int "CLK GPIO number (-1 = hardware IOMUX default)"
        default -1
        help
            GPIO number to use for SDMMC CLK via the GPIO matrix.
            Set to -1 to rely on the hardware IOMUX default pin assignment
            for the selected SDMMC slot.

    config SD_CMD_GPIO
        int "CMD GPIO number (-1 = hardware IOMUX default)"
        default -1
        help
            GPIO number to use for SDMMC CMD via the GPIO matrix.
            Set to -1 to rely on the hardware IOMUX default pin assignment.

    config SD_D0_GPIO
        int "D0 GPIO number (-1 = hardware IOMUX default)"
        default -1
        help
            GPIO number to use for SDMMC D0 via the GPIO matrix.
            Set to -1 to rely on the hardware IOMUX default pin assignment.

    config SD_BUS_WIDTH
        int "Bus width (1 or 4)"
        default 4
        help
            SDMMC bus width. Use 1 for single-wire SDIO (only D0 connected),
            or 4 for full 4-bit mode.

    config SD_INTERNAL_PULLUP
        bool "Enable internal pull-up resistors on SDMMC lines"
        default n
        help
            Enable the internal pull-up resistors on the SDMMC signal lines.
            Useful when the board does not provide external pull-ups on the
            SD card signals.

endmenu
```

## components/wave_4b/Kconfig
```kconfig
menu "Board Support Package (Waveshare ESP32-P4 4B)"
    depends on KERN_BOARD_WAVE_4B

    config BSP_ERROR_CHECK
        bool "Enable error check in BSP"
        default y
        help
            Error check assert the application before returning the error code.

    menu "I2C"
        config BSP_I2C_NUM
            int "I2C peripheral index"
            default 1
            range 0 1
            help
                ESP32P4 has two I2C peripherals, pick the one you want to use.

        config BSP_I2C_FAST_MODE
            bool "Enable I2C fast mode"
            default y
            help
                I2C has two speed modes: normal (100kHz) and fast (400kHz).

        config BSP_I2C_CLK_SPEED_HZ
            int
            default 400000 if BSP_I2C_FAST_MODE
            default 100000
    endmenu

    menu "Display"
        config BSP_LCD_DPI_BUFFER_NUMS
            int "Set number of frame buffers"
            default 1
            range 1 3
            help
                Let DPI LCD driver create a specified number of frame-size buffers.

        config BSP_DISPLAY_BRIGHTNESS_LEDC_CH
            int "LEDC channel index"
            default 1
            range 0 7
            help
                LEDC channel is used to generate PWM signal that controls display brightness.

        choice BSP_LCD_COLOR_FORMAT
            prompt "Select LCD color format"
            default BSP_LCD_COLOR_FORMAT_RGB565
            help
                Select the LCD color format RGB565/RGB888.

            config BSP_LCD_COLOR_FORMAT_RGB565
                bool "RGB565"
            config BSP_LCD_COLOR_FORMAT_RGB888
                bool "RGB888"
        endchoice

    endmenu

endmenu
```

## sdkconfig.defaults.crowpanel
```kconfig
# Board: CrowPanel Advanced ESP32-P4 (7" / 10.1", 1024x600 MIPI DSI)
CONFIG_KERN_BOARD_CROWPANEL=y
CONFIG_LV_FONT_MONTSERRAT_24=y
CONFIG_LV_FONT_MONTSERRAT_34=y
CONFIG_ESPTOOLPY_FLASHMODE_QIO=y
CONFIG_SD_BUS_WIDTH=1
CONFIG_SD_INTERNAL_PULLUP=y
# SC2336 needs the ISP pipeline controller to run AWB/AGC/CCM — without it the image comes out green and clipped. IPA algorithms default to y, so enabling the controller is enough to bring them online via the sensor's default JSON.
CONFIG_ESP_VIDEO_ENABLE_ISP_PIPELINE_CONTROLLER=y
# Move the isp_task stack to PSRAM: the controller's stats/AWB loop isn't latency-critical and frees scarce internal DRAM. Safe here — isp_task never writes flash.
CONFIG_ISP_PIPELINE_CONTROLLER_TASK_STACK_USE_PSRAM=y
# Custom IPA tuning: the stock eco4 JSON applies gamma 0.518 with no black-level correction, lifting near-black (16/255) to 25% grey. Kern's copy anchors the curve at the sensor pedestal (x<=16 -> 0) with a milder gamma 0.75; everything else matches the eco4 default.
CONFIG_CAMERA_SC2336_CUSTOMIZED_IPA_JSON_CONFIGURATION_FILE=y
CONFIG_CAMERA_SC2336_CUSTOMIZED_IPA_JSON_CONFIGURATION_FILE_PATH="components/video/cfg/sc2336_kern.json"
```

## sdkconfig.defaults.crowpanel_101
```kconfig
# Board: CrowPanel Advanced 10.1" ESP32-P4 (1024x600 MIPI DSI)
CONFIG_KERN_BOARD_CROWPANEL_101=y
CONFIG_ESPTOOLPY_FLASHMODE_QIO=y
CONFIG_SD_BUS_WIDTH=1
CONFIG_SD_INTERNAL_PULLUP=y
```

## sdkconfig.defaults.wave_35
```kconfig
# Board: Waveshare ESP32-P4-WiFi6-Touch-LCD-3.5 (320x480 SPI)
CONFIG_KERN_BOARD_WAVE_35=y
CONFIG_LV_FONT_MONTSERRAT_16=y
CONFIG_ESPTOOLPY_FLASHMODE_DIO=y
CONFIG_SPIRAM_MODE_HEX=y
CONFIG_SPIRAM_XIP_FROM_PSRAM=n
```

## sdkconfig.defaults.wave_43
```kconfig
# Board: Waveshare ESP32-P4-WiFi6-Touch-LCD-4.3 (480x800 MIPI DSI)
CONFIG_KERN_BOARD_WAVE_43=y
CONFIG_LV_FONT_MONTSERRAT_16=y
CONFIG_ESPTOOLPY_FLASHMODE_QIO=y
```

## sdkconfig.defaults.wave_4b
```kconfig
# Board: Waveshare ESP32-P4-WiFi6-Touch-LCD-4B (720x720 MIPI DSI)
CONFIG_KERN_BOARD_WAVE_4B=y
CONFIG_LV_FONT_MONTSERRAT_24=y
CONFIG_LV_FONT_MONTSERRAT_32=y
CONFIG_ESPTOOLPY_FLASHMODE_QIO=y
CONFIG_CAM_MOTOR_DW9714=y
```

## sdkconfig.defaults.wave_5
```kconfig
# Board: Waveshare ESP32-P4-WiFi6-Touch-LCD-5 (720x1280 MIPI DSI)
CONFIG_KERN_BOARD_WAVE_5=y
CONFIG_LV_FONT_MONTSERRAT_28=y
CONFIG_LV_FONT_MONTSERRAT_40=y
CONFIG_ESPTOOLPY_FLASHMODE_QIO=y
```
